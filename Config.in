## configs/jaspiradio0_defconfig
```kconfig
BR2_arm=y
BR2_arm1176jzf_s=y
BR2_GLOBAL_PATCH_DIR="$(BR2_EXTERNAL_JASPIRADIO_PATH)/patches/"
BR2_TOOLCHAIN_BUILDROOT_GLIBC=y
BR2_PACKAGE_HOST_LINUX_HEADERS_CUSTOM_4_19=y
BR2_TOOLCHAIN_BUILDROOT_CXX=y
BR2_TARGET_GENERIC_HOSTNAME="jaspiradio"
BR2_TARGET_GENERIC_ISSUE="Welcome to The Radio"
BR2_SYSTEM_DHCP="eth0"
BR2_ROOTFS_OVERLAY="$(BR2_EXTERNAL_JASPIRADIO_PATH)/board/jaspiradio/overlay/"
BR2_ROOTFS_POST_BUILD_SCRIPT="board/raspberrypi0w/post-build.sh $(BR2_EXTERNAL_JASPIRADIO_PATH)/board/jaspiradio/post-build.sh"
BR2_ROOTFS_POST_IMAGE_SCRIPT="board/raspberrypi0w/post-image.sh"
BR2_ROOTFS_POST_SCRIPT_ARGS="--add-pi3-miniuart-bt-overlay"
BR2_LINUX_KERNEL=y
BR2_LINUX_KERNEL_CUSTOM_TARBALL=y
BR2_LINUX_KERNEL_CUSTOM_TARBALL_LOCATION="$(call github,raspberrypi,linux,5eeff139ea9135db6e01a58ef613338f1d0899d8)/linux-5eeff139ea9135db6e01a58ef613338f1d0899d8.tar.gz"
BR2_LINUX_KERNEL_USE_CUSTOM_CONFIG=y
BR2_LINUX_KERNEL_CUSTOM_CONFIG_FILE="$(BR2_EXTERNAL_JASPIRADIO_PATH)/board/jaspiradio/linux_minimal.config"
BR2_LINUX_KERNEL_DTS_SUPPORT=y
BR2_LINUX_KERNEL_INTREE_DTS_NAME="bcm2708-rpi-0-w"
BR2_LINUX_KERNEL_DTB_OVERLAY_SUPPORT=y
BR2_LINUX_KERNEL_NEEDS_HOST_OPENSSL=y
BR2_PACKAGE_LINUX_TOOLS_CPUPOWER=y
BR2_PACKAGE_LINUX_TOOLS_GPIO=y
BR2_PACKAGE_BUSYBOX_CONFIG="$(BR2_EXTERNAL_JASPIRADIO_PATH)/board/jaspiradio/busybox.config"
BR2_PACKAGE_ALSA_UTILS=y
BR2_PACKAGE_MPD=y
BR2_PACKAGE_MPD_BZIP2=y
BR2_PACKAGE_MPD_SQLITE=y
BR2_PACKAGE_MPD_AUDIOFILE=y
BR2_PACKAGE_MPD_DSD=y
BR2_PACKAGE_MPD_FAAD2=y
BR2_PACKAGE_MPD_FFMPEG=y
BR2_PACKAGE_MPD_FLAC=y
BR2_PACKAGE_MPD_LIBSNDFILE=y
BR2_PACKAGE_MPD_MPG123=y
BR2_PACKAGE_MPD_MUSEPACK=y
BR2_PACKAGE_MPD_OPUS=y
BR2_PACKAGE_MPD_TREMOR=y
BR2_PACKAGE_MPD_VORBIS=y
BR2_PACKAGE_MPD_CURL=y
BR2_PACKAGE_MPD_LIBMMS=y
BR2_PACKAGE_MPD_SOUNDCLOUD=y
BR2_PACKAGE_MPD_LIBMPDCLIENT=y
BR2_PACKAGE_MPD_MPC=y
BR2_PACKAGE_RPI_FIRMWARE=y
BR2_PACKAGE_RPI_WIFI_FIRMWARE=y
BR2_PACKAGE_PIGPIO=y
BR2_PACKAGE_PYTHON3=y
BR2_PACKAGE_PYTHON_PIP=y
BR2_PACKAGE_PYTHON_REQUESTS=y
BR2_PACKAGE_PYTHON_RPI_GPIO=y
BR2_PACKAGE_ELL=y
BR2_PACKAGE_CRDA=y
BR2_PACKAGE_IW=y
BR2_PACKAGE_NTP=y
# BR2_PACKAGE_NTP_NTPD is not set
BR2_PACKAGE_NTP_NTPDATE=y
BR2_PACKAGE_WIRELESS_TOOLS=y
BR2_PACKAGE_WPA_SUPPLICANT=y
BR2_PACKAGE_WPA_SUPPLICANT_AUTOSCAN=y
BR2_PACKAGE_WPA_SUPPLICANT_EAP=y
BR2_PACKAGE_WPA_SUPPLICANT_CLI=y
BR2_PACKAGE_WPA_SUPPLICANT_PASSPHRASE=y
BR2_TARGET_ROOTFS_EXT2=y
BR2_TARGET_ROOTFS_EXT2_4=y
BR2_TARGET_ROOTFS_EXT2_SIZE="100M"
# BR2_TARGET_ROOTFS_TAR is not set
BR2_PACKAGE_HOST_DOSFSTOOLS=y
BR2_PACKAGE_HOST_GENIMAGE=y
BR2_PACKAGE_HOST_MKPASSWD=y
BR2_PACKAGE_HOST_MTOOLS=y
```
